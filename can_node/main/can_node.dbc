VERSION ""

NS_ :

BS_:

BU_: CMD ACT

BO_ 80 THROTTLE_CMD: 2 CMD
 SG_ Throttle : 0|8@1+ (0.5,0) [0|100] "%" ACT
 SG_ Enable : 8|1@1+ (1,0) [0|1] "" ACT

BO_ 256 CMD_HEARTBEAT: 2 CMD
 SG_ Counter : 0|8@1+ (1,0) [0|255] "" ACT
 SG_ State : 8|8@1+ (1,0) [0|3] "" ACT

BO_ 257 ACT_HEARTBEAT: 2 ACT
 SG_ Counter : 0|8@1+ (1,0) [0|255] "" CMD
 SG_ State : 8|8@1+ (1,0) [0|3] "" CMD

BO_ 512 WHEEL_SPEED: 2 ACT
 SG_ Speed : 0|16@1+ (0.01,0) [0|655.35] "m/s" CMD
